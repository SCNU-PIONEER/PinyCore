## Kconfig
```kconfig
mainmenu "Piny Development Framework Configuration"

choice 
    prompt "target config"
    default TARGET_MASTER

    config TARGET_MASTER
        bool "master"
        help
            select config as master

    config TARGET_SLAVE
        bool "slave"
        help
            select config as slave
endchoice

source "Src/Common/Soc/Kconfig"

source "Src/App/Kconfig"

source "Src/Common/Bsp/Kconfig"

source "Src/Common/Extensions/Kconfig"

source "Src/Utils/Kconfig"

source "Src/Kconfig.debug"
```

## Src/App/Kconfig
```kconfig
menu "app config"

    config APP_USE_CHASSIS
    bool "chassis"
    default y

    source "Src/App/RobotModules/Chassis/Kconfig"

    config APP_USE_GIMBAL
    bool "gimbal"
    default n

    source "Src/App/RobotModules/Gimbal/Kconfig"

    config APP_USE_TEST
    bool "test modules"
    default n

    source "Src/App/Test/Kconfig"

    config APP_USE_INS
    bool "ins"
    default n
    depends on EXTENSION_SENSOR

    source "Src/System/INS/Kconfig"

    config APP_USE_DAEMONS
    bool "daemons"
    default n

    config APP_USE_COMM
    bool "muti communication"
    default n

    config APP_USE_UI
    bool "UI"
    default n

endmenu
```

## Src/App/MessageCenter/Kconfig
```kconfig
menu "messagecenter config"
    depends on APP_USE_MESSAGECENTER
    choice

        prompt "MessageCenter Type"
        default MASTER_MESSAGECENTER

        config MASTER_MESSAGECENTER
            bool "Master MessageCenter"
            depends on TARGET_MASTER

        config SLAVE_MESSAGECENTER
            bool "Slave MessageCenter"
            depends on TARGET_SLAVE

    endchoice

    config MESSAGECENTER_TYPE
        string 
        default "MasterMC" if MASTER_MESSAGECENTER
        default "SlaveMC" if SLAVE_MESSAGECENTER


endmenu
```

## Src/App/RobotModules/ArmorBooster/Kconfig
```kconfig
menu "ArmorBooster config"
    depends on APP_USE_ARMORBOOSTER

    choice

        prompt "ArmorBooster type"
        default APP_USE_DUAL

        config APP_USE_DUAL
            bool "dual"

    endchoice

    config ARMORBOOSTER_TYPE
        string
        default "DualFric" if APP_USE_DUAL

    config ARMORBOOSTER_FILE
        string
        default '"DualFric.hpp"' if APP_USE_DUAL

endmenu
```

## Src/App/RobotModules/ArmorLoader/Kconfig
```kconfig
menu "ArmorLoader config"
    depends on APP_USE_ARMORLOADER

    choice

        prompt "ArmorLoader type"
        default APP_USE_DIAL

        config APP_USE_DIAL
            bool "dial"

    endchoice

    config ARMORLOADER_TYPE
        string
        default "Dial" if APP_USE_DIAL

    config ARMORLOADER_FILE
        string
        default '"Dial.hpp"' if APP_USE_DIAL

endmenu
```

## Src/App/RobotModules/Chassis/Kconfig
```kconfig
menu "chassis config"
    depends on APP_USE_CHASSIS

    choice

        prompt "chassis type"
        default APP_USE_MECANUM

        config APP_USE_MECANUM
            bool "mecanum"
        config APP_USE_SWERVE
            bool "swerve"

    endchoice

    config CHASSIS_TYPE
        string
        default "Mecanum" if APP_USE_MECANUM
        default "Swerve"  if APP_USE_SWERVE

    config CHASSIS_FILE
        string
        default '"Mecanum.hpp"' if APP_USE_MECANUM
        default '"Swerve.hpp"'  if APP_USE_SWERVE

    config APP_USE_POWERCTRL
    bool "power control"
    default n

    source "Src/App/RobotModules/Chassis/PowerCtrl/Kconfig"

    config APP_USE_ODOMETER
    bool "odometer"
    default n

endmenu
```

## Src/App/RobotModules/Chassis/PowerCtrl/Kconfig
```kconfig
    menu "power control settings"
    depends on APP_USE_POWERCTRL

    config POWERCTRL_USE_RLS
        bool "rls"
        default y

    config ENABLE_STEER_RLS
        bool "enable steer rls"
        default n

    endmenu
```

## Src/App/RobotModules/Gimbal/Kconfig
```kconfig
menu "gimbal config"
    depends on APP_USE_GIMBAL

    choice

        prompt "gimbal type"
        default APP_USE_STANDARD

        config APP_USE_STANDARD
            bool "standard"
        config APP_USE_DUALSTAGE
            bool "DualStage"

    endchoice

    config GIMBAL_TYPE
        string
        default "Standard" if APP_USE_STANDARD
        default "DualStage"  if APP_USE_DUALSTAGE
        default "ThreeAxle" if APP_USE_THREEAXLE

    config GIMBAL_FILE
        string
        default '"Standard.hpp"' if APP_USE_STANDARD
        default '"DualStage.hpp"'  if APP_USE_DUALSTAGE
        default '"ThreeAxel.hpp"' if APP_USE_THREEAXLE

endmenu
```

## Src/App/Test/Kconfig
```kconfig
menu "test motor"
depends on APP_USE_TEST

config TEST_DM
    bool "damiao"
    default n

config TEST_DJI
    bool "dji"
    default n

config TEST_LK
    bool "lk"
    default n
    source "Src/App/Test/TestLK/Kconfig"

config TEST_MT
    bool "MT"
    default n
endmenu
```

## Src/App/Test/TestLK/Kconfig
```kconfig
menu "LKMotor Communication Test"

    depends on TEST_LK

    choice
        prompt "Select Communication"
        default LKTEST_CAN

        config LKTEST_CAN
            bool "CAN"
        config LKTEST_RS485
            bool "RS485"
        config LKTEST_CAN_BROADCAST
            bool "Can Broadcast"
        config LKTEST_RS485_BROADCAST
            bool "RS485 Broadcast"
    endchoice

endmenu
```

## Src/App/UI/Kconfig
```kconfig
menu "UI config"
    choice
        prompt "robot id"
        default RED_HERO
        depends on APP_USE_UI

        config RED_HERO
            bool "red hero"
        config RED_ENGINEER
            bool "red engineer"
        config RED_INFANTRY_3
            bool "red infantry 3"
        config RED_INFANTRY_4
            bool "red infantry 4"
        config RED_INFANTRY_5
            bool "red infantry 5"
        config RED_AERIAL
            bool "red aerial"
        config RED_SENTRY
            bool "red sentry"
        config RED_DART
            bool "red dart"
        config BLUE_HERO
            bool "blue hero"
        config BLUE_ENGINEER
            bool "blue engineer"
        config BLUE_INFANTRY_3
            bool "blue infantry 3"
        config BLUE_INFANTRY_4
            bool "blue infantry 4"
        config BLUE_INFANTRY_5
            bool "blue infantry 5"
        config BLUE_AERIAL
            bool "blue aerial"
        config BLUE_SENTRY
            bool "blue sentry"
        config BLUE_DART
            bool "blue dart"
    endchoice

    config UI_ROBOT_ID
        int
        default 1 if RED_HERO
        default 2 if RED_ENGINEER
        default 3 if RED_INFANTRY_3
        default 4 if RED_INFANTRY_4
        default 5 if RED_INFANTRY_5
        default 6 if RED_AERIAL
        default 7 if RED_SENTRY
        default 8 if RED_DART
        default 101 if BLUE_HERO
        default 102 if BLUE_ENGINEER
        default 103 if BLUE_INFANTRY_3
        default 104 if BLUE_INFANTRY_4
        default 105 if BLUE_INFANTRY_5
        default 106 if BLUE_AERIAL
        default 107 if BLUE_SENTRY
        default 108 if BLUE_DART
        default 0 if !APP_USE_UI

endmenu
```

## Src/Common/Bsp/Kconfig
```kconfig
menu "Bsp config"
    config BSP_USE_CAN
        bool "can/fdcan"
        default y

    config BSP_USE_DMA
        bool "dma"
        default y

    config BSP_USE_PWM
        bool "pwm"
        default y

    config BSP_USE_UART
        bool "uart/usart" 
        default y

    config BSP_USE_SPI
        bool "spi"
        default y

    config BSP_USE_IIC
        bool "iic"
        default n

    config BSP_USE_TIM
        bool "tim"
        default y
endmenu
```

## Src/Common/Extensions/Kconfig
```kconfig
menu "extension config"
    config EXTENSION_RC
    bool "remote control"
    default n

     source "Src/Common/Extensions/RemoteControl/Kconfig"
    
    config EXTENSION_BUZZER
    bool "buzzer"
    default y

    config EXTENSION_LED
    bool "led"
    default n

    source "Src/Common/Extensions/LED/Kconfig"

    config EXTENSION_MOTOR
    bool "motor driver"
    default n

    select USE_MATHEMATICA_CRC

    source "Src/Common/Extensions/Motor/Core/Imp/LK/Kconfig"

    config EXTENSION_REFEREE
    bool "referee"
    default n

    config EXTENSION_SENSOR
    bool "sensor"
    default y

    config EXTENSION_SUPERCAP
    bool "super cap"
    default n

endmenu
```

## Src/Common/Extensions/LED/Kconfig
```kconfig
menu "LEDDriver config"
    depends on EXTENSION_LED
    
    config LED_WS2812_SPI
    bool "ws2812-spi"
    default n

    config LED_WS2812_PWM
    bool "ws2812-pwm"
    default n

    config LED_RGBLED
    bool "rgbled"
    default n

endmenu
```

## Src/Common/Extensions/Motor/Core/Imp/Kconfig
```kconfig
menu "Motor driver selection"
    config MOTOR_DRIVER_DAMIAO
    bool "DAMIAO"
    default n

    config MOTOR_DRIVER_DJI
    bool "DJI"
    default n

    config MOTOR_DRIVER_DJI_OLD
    bool "DJI old"
    default n

    config MOTOR_DRIVER_LK
    bool "LK"
    default n

    if MOTOR_DRIVER_LK
        source "Src/Common/Extensions/Motor/Core/Imp/LK/Kconfig"
    endif

    config MOTOR_DRIVER_MAITA
    bool "MAITA"
    default n

    config MOTOR_DRIVER_UNITREE
    bool "Unitree"
    default n
endmenu
```

## Src/Common/Extensions/Motor/Core/Imp/LK/Kconfig
```kconfig
if MOTOR_LK_MF9025

choice
    prompt "MF9025 communication"
    default MF9025_CAN

    config MF9025_CAN
        bool "CAN"
    config MF9025_RS485
        bool "RS485"
    config MF9025_CAN_BROADCAST
        bool "Can Broadcast"
    config MF9025_RS485_BROADCAST
        bool "RS485 Broadcast"
endchoice

endif

if MOTOR_LK_MG4005

choice
    prompt "MG4005 communication"
    default MG4005_CAN

    config MG4005_CAN
        bool "CAN"
    config MG4005_RS485
        bool "RS485"
    config MG4005_CAN_BROADCAST
        bool "Can Broadcast"
    config MG4005_RS485_BROADCAST
        bool "RS485 Broadcast"
endchoice

endif

if MOTOR_LK_MG8016EI6_RS485

choice
    prompt "MG8016Ei6 communication"
    default MG8016Ei6_RS485

    config MG8016Ei6_CAN
        bool "CAN"
    config MG8016Ei6_RS485
        bool "RS485"
    config MG8016Ei6_CAN_BROADCAST
        bool "Can Broadcast"
    config MG8016Ei6_RS485_BROADCAST
        bool "RS485 Broadcast"
endchoice

endif
```

## Src/Common/Extensions/Motor/Kconfig
```kconfig
menu "Motor Drivers"

    depends on EXTENSION_MOTOR

    config MOTOR_DJI
        bool "DJI motors"
        default n
    menu "DJI config"
        depends on MOTOR_DJI
        config MOTOR_DJI_M3508
            bool "M3508"
            default n
        config MOTOR_DJI_M2006
            bool "M2006"
            default n
        config MOTOR_DJI_GM6020
            bool "GM6020"
            default n
    endmenu

    config MOTOR_DJI_OD
        bool "DJI old motors"
        default n
    menu "DJI old config"
        depends on MOTOR_DJI_OD
        config MOTOR_DJI_OD_GM3510
            bool "GM3510"
            default n
    endmenu

    config MOTOR_DAMIAO
        bool "DAMIAO motors"
        default n
    menu "DAMIAO config"
        depends on MOTOR_DAMIAO
        config MOTOR_DM10010L
            bool "DM10010L"
            default n
        config MOTOR_DM3507
            bool "DM3507"
            default n
        config MOTOR_DM3519
            bool "DM3519"
            default n
        config MOTOR_DM4310
            bool "DM4310"
            default n
        config MOTOR_DM4340
            bool "DM4340"
            default n
        config MOTOR_DM6006
            bool "DM6006"
            default n
        config MOTOR_DM8009
            bool "DM8009"
            default n
    endmenu

    config MOTOR_MAITA
        bool "MAITA motors"
        default n
    menu "MAITA config"
        depends on MOTOR_MAITA
        config MOTOR_RMD_X2_7
            bool "RMD-X2-7"
            default n
        config MOTOR_RMD_X4_10
            bool "RMD-X4-10"
            default n
        config MOTOR_RMD_X4_36
            bool "RMD-X4-36"
            default n
    endmenu

    config MOTOR_UNITREE
        bool "Unitree motors"
        default n
    menu "Unitree config"
        depends on MOTOR_UNITREE
        config MOTOR_UT8010_6
            bool "UT8010-6"
            default n
    endmenu

    config MOTOR_LK
        bool "LK motors"
        default n
    menu "LK config"
        depends on MOTOR_LK
        source "Src/Common/Extensions/Motor/Core/Imp/LK/Kconfig"
    endmenu

endmenu
```

## Src/Common/Extensions/RemoteControl/Kconfig
```kconfig
menu "Remote Control config"
    depends on EXTENSION_RC

    config EXTENSION_DT7
        bool "remote control dt7"
    default n  

    config EXTENSION_ET08A
        bool "remote control et08a"
    default n 

    config EXTENSION_VT13
        bool "remote control vt13"
    default n 

endmenu
```

## Src/Common/Soc/Kconfig
```kconfig
menu "Soc config"
    choice
        prompt "Soc target choice"
        default TARGET_STM32F407IGHX

        config TARGET_STM32F407IGHX
        bool "STM32F407IGHX"

        source "Src/Common/Soc/stm32f407ighx/Kconfig"

        config TARGET_STM32F103C8TX
        bool "STM32F103C8TX"

        source "Src/Common/Soc/stm32f103c8tx/Kconfig"

        config TARGET_STM32H723VGTX
        bool "STM32H723VGTX"

        source "Src/Common/Soc/stm32h723vgtx/Kconfig"

    endchoice

    config SOC_USE_CUSTOM
    bool "custom soc"
    default n

endmenu
```

## Src/Common/Soc/stm32h723/Kconfig
```kconfig
menu "STM32H723 Soc config"
    depends on TARGET_STM32H723

    config SOC_CUSTOM_USE_SPI3
    bool "custom SPI3"
    default n

endmenu
```

## Src/Kconfig.debug
```kconfig
menu "Kernel hacking"

    config RTOS_DEBUG
    bool "generate rtos debug info"
    default y
	  help
        在vscode中调试打断点不再会在task.c中暂停，
        并且不会在任意地方断点暂停，需要手动声明断点

    config USE_VSCODE_XRTOS
    bool "vscode plugin: freertos task analyze"
    default n
    depends on RTOS_DEBUG
    help
        在vscode中使用xrtos插件分析freertos的task信息
        需要配合RTOS_DEBUG选项使用

endmenu
```
