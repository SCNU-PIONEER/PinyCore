## Src/System/BoardComm/Kconfig
```kconfig
menu "Board config"
    config BOARD_USE_COMM
        bool "communication"
        default y

    menu "Board communication config"
        depends on BOARD_USE_COMM

        choice
            prompt "board type"
            default BOARD_MASTER
            
            config BOARD_MASTER
                bool "master"
                default y

            config BOARD_SLAVE
                bool "slave"
                default n

        endchoice
    endmenu
    
endmenu
```

## Src/System/Components/Comm/Kconfig
```kconfig
menu "muti-communication config"
    depends on APP_USE_COMM

    choice

        prompt "core type"
        default APP_GIMBAL_MASTER

        config APP_GIMBAL_MASTER
            bool "gimbal master"
        config APP_CHASSIS_SLAVE
            bool "chassis slave"

    endchoice
endmenu
```

## Src/System/MiniPc/Kconfig
```kconfig
menu "MiniPc config" 
    depends on APP_USE_MINIPC

        config APP_USE_VISION
        bool "vision"
        default n

        config APP_USE_NAV
        bool "nav"
        default n
endmenu
```

## Src/System/Nav/Kconfig
```kconfig
menu "NAV config" 
    depends on APP_USE_NAV

        choice

            prompt "Communication method"
            default NAV_COMM_USB 

            config NAV_COMM_UART 
                bool "NAV_UART" 
            config NAV_COMM_USB 
                bool "NAV_USB"
        endchoice
endmenu
```

## Src/Utils/Kconfig
```kconfig
menu "utils config"
    config USE_MATHEMATICA
        bool "mathematica"
        default y
    
    source "Src/Utils/Mathematica/Kconfig"

    config USE_DWT
        bool "Dwt timer"
        default y
    config USE_FSM
        bool "Finite State Machine"
        default y
    config USE_HARDFAULT 
        bool "segger hardfault handle"
        default y
    config USE_STM_LOG
        bool "stm log"
        default y
        
    source "Src/Utils/Log/Kconfig"

    config USE_LAZY
        bool "lazy init"
        default y
    config USE_SINGLETON
        bool "singleton class base"
        default y
endmenu
```

## Src/Utils/Log/Kconfig
```kconfig
menu "Log config"
    depends on USE_STM_LOG

    config LOG_MAX_RAW_LENGTH
        int "Max raw log length"
        range 1 1024
        default 128
    
    config LOG_MAX_LOG_LENGTH
        int "Max log length"
        range 1 1024
        default 128

    config LOG_SHOW_COLOR
        bool "Color log"
        default y
        help
            Show the log with color.
    
    config LOG_SHOW_TIMESTAMP
        bool "Timestamp log"
        default n
        help
            Show the timestamp in logs by using the RTOS tick count.

    config LOG_SHOW_LOCATION
        bool "Location log"
        default n
        help
            Show the file and line number in logs.

    config LOG_OUTPUT_RTT
        bool "SEGGER RTT log output"
        default y

    config LOG_OUTPUT_UART
        bool "UART log output"
        default n
        depends on BSP_USE_UART
        depends on BSP_USE_DMA
        help 
            Enable UART log output. This option requires BSP_USE_UART and BSP_USE_DMA to be enabled.


endmenu
```

## Src/Utils/Mathematica/Kconfig
```kconfig
menu "mathematica config"
    depends on USE_MATHEMATICA

    config USE_MATHEMATICA_BALLISTIC
        bool "Ballistic"
        default n

    config USE_MATHEMATICA_CORDIC
        bool "Cordic"
        default n

    config USE_MATHEMATICA_CRC
        bool "CRC"
        default n

    config USE_MATHEMATICA_FFT
        bool "FFT"
        default n

    config USE_MATHEMATICA_FILTER
        bool "Filter"
        default n

    config USE_MATHEMATICA_KF
        bool "Kalman Filter"
        default n

    config USE_MATHEMATICA_LQR
        bool "LQR"
        default n

    config USE_MATHEMATICA_MATRIX
        bool "Matrix"
        default n

    config USE_MATHEMATICA_OLS
        bool "OLS"
        default n

    config USE_MATHEMATICA_PID
        bool "PID"
        default n

    config USE_MATHEMATICA_RAMP
        bool "Ramp"
        default n

    config USE_MATHEMATICA_RICCATI
        bool "Riccati"
        default n

    config USE_MATHEMATICA_RLS
        bool "RLS"
        default n

    config USE_MATHEMATICA_SMC
        bool "SMC"
        default n

    config USE_MATHEMATICA_SMOOTH
        bool "Smooth"
        default n
endmenu
```
